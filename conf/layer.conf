## conf/layer.conf
```bitbake
# We have a conf and classes directory, add to BBPATH
BBPATH .= ":${LAYERDIR}"

# We have recipes-* directories, add to BBFILES
BBFILES += "${LAYERDIR}/recipes-*/*/*.bb \
	${LAYERDIR}/recipes-*/*/*.bbappend"

BBFILE_COLLECTIONS += "tq-distro-fsl"
BBFILE_PATTERN_tq-distro-fsl = "^${LAYERDIR}/"
BBFILE_PRIORITY_tq-distro-fsl = "6"
```

## conf/machine/tqma6dl-mba6x-gui.conf
```bitbake
#@TYPE: Machine
#@NAME: TQ-Group TQMa6DL Module on MBa6x Baseboard
#@SOC: i.MX6Q
#@DESCRIPTION: Machine configuration for TQ-Group TQMa6 Quad / Dual
#@MAINTAINER: Marco Felsch <Marco.Felsch@tq-group.com>
#
# Processor           Memory    Configuration
# --------------      ------    --------------------
# i.MX6 DualLight     1GB     tqma6dl_mba6_mmc_defconfig
#

# Note: this should realy be done as a distro, bbut I havn't found 
# out how to accomplish

# source the board support from meta-tq
require conf/machine/tqma6dl-mba6x.conf
# source the machine specific features for multimedia etc. from meta-fsl-arm
require conf/machine/include/imx-base.inc
```

## conf/machine/tqma6q-nav-gui.conf
```bitbake
#@TYPE: Machine
#@NAME: TQ-Group TQMa6[Q,D] Module on NAV Baseboard
#@SOC: i.MX6Q
#@DESCRIPTION: Machine configuration for TQ-Group TQMa6 Quad / Dual
#@MAINTAINER: Marco Felsch <Marco.Felsch@tq-group.com>
#
# Processor           Memory    Configuration
# --------------      ------    --------------------
# i.MX6Quad/Dual        1GB     tqma6q_nav_mmc_defconfig
#

# Note: this should realy be done as a distro, bbut I havn't found 
# out how to accomplish

# source the board support from meta-tq
require conf/machine/tqma6q-nav.conf
# source the machine specific features for multimedia etc. from meta-fsl-arm
require conf/machine/include/imx-base.inc
```
